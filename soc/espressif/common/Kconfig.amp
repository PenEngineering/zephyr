## soc/espressif/common/Kconfig.amp
```kconfig
# Copyright (c) 2023 Espressif Systems (Shanghai) Co., Ltd.
# SPDX-License-Identifier: Apache-2.0

config SOC_ENABLE_APPCPU
	bool
	default y
	depends on (IPM || MBOX)
	depends on SOC_SERIES_ESP32 || SOC_SERIES_ESP32S3
	help
	  This hidden configuration lets PROCPU core to map and start APPCPU whenever IPM is enabled.

config ESP_APPCPU_AUTOLOAD_IMAGE
	bool "Auto-load a separate APPCPU image from flash at boot"
	default y
	depends on SOC_ENABLE_APPCPU
	help
	  The stock Zephyr AMP flow: at boot, PROCPU loads a SEPARATE Zephyr
	  image for APPCPU from a slot0_appcpu_partition flash partition
	  (built via sysbuild) and starts it. Requires that partition to
	  exist with a valid image, or esp_appcpu_init() aborts at boot.
	  Disable this if APPCPU is started manually, later, from a single
	  image (e.g. via esp_appcpu_start()/arch_cpu_start() with a raw
	  IRAM function pointer already linked into the PROCPU binary) —
	  no separate image or partition needed in that case.

menu "Espressif AMP Config"

config ESP_APPCPU_IRAM_SIZE
	hex "ESP32* APPCPU IRAM size"
	default 0x10000
	help
	  Defines APPCPU IRAM area size in bytes.

config ESP_APPCPU_DRAM_SIZE
	hex "ESP32* APPCPU DRAM size"
	default 0x10000
	help
	  Defines APPCPU DRAM area size in bytes.

config ESP_APPCPU_IROM_SIZE
	hex "ESP32* APPCPU IROM size"
	default 0x100000
	help
	  Defines APPCPU IROM area size in bytes.

config ESP_APPCPU_DROM_SIZE
	hex "ESP32* APPCPU DRAM size"
	default 0x100000
	help
	  Defines APPCPU DROM area size in bytes.

endmenu # AMP config
```

## subsys/usb/host/class/Kconfig.msc
```kconfig
# Copyright (c) 2026 AkiraOS Contributors
#
# SPDX-License-Identifier: Apache-2.0

config USBH_MASS_STORAGE_CLASS
	bool "USB host Mass Storage class (Bulk-Only Transport + SCSI)"
	help
	  Enable the USB host Mass Storage class driver. Speaks Bulk-Only
	  Transport and a minimal SCSI command set (TEST UNIT READY, READ
	  CAPACITY(10), READ(10), WRITE(10)) to a connected USB mass-storage
	  device (e.g. a flash drive) and exposes it as a disk_access disk
	  named "USB".

if USBH_MASS_STORAGE_CLASS

config USBH_MASS_STORAGE_CLASS_LOG_LEVEL
	int "Log level for USB host MSC class"
	default 3
	range 0 4

endif # USBH_MASS_STORAGE_CLASS
```
